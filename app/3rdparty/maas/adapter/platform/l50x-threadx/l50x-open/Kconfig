## app/3rdparty/maas/adapter/platform/l50x-threadx/l50x-open/Kconfig
```kconfig
config BOT_PLATFORM_L50X_THREADX
    bool "L50x"
    help
        device l50x

if BOT_PLATFORM_L50X_THREADX
    config BOT_PLATFORM_SYMBEL_RENAME_CONFIG
        bool "enable rdefine symbl"
        default n
        help
            enable rdefine symbl, according to bot.sym
        
    config BOT_PLATFORM_MULTI_LIB_CONFIG
        bool "enable multy libs"
        default n
        help
            enable multy libs
endif
```

## app/config/1602/Kconfig
```kconfig
# Kconfig - app target configuration options

choice 
	prompt "APP Target Selection" 
	default L511C_2S
	
	#####################
	#L503C_2L
	#####################
	config L503C_2L
		bool "L503C_2L"
	
	#####################
	#L503C_2S
	#####################
	config L503C_2S
		bool "L503C_2S"
	
	#####################
	#L511C_2S
	#####################
	config L511C_2S
		bool "L511C_2S"
		
    #####################
	#L511C_X2S
	#####################
	config L511C_X2S
		bool "L511C_X2S"
		
	#####################
	#L511CN_2S
	#####################
	config L511CN_2S
		bool "L511CN_2S"

	#####################
	#L511CN_2S_NF
	#####################
	config L511CN_2S_NF
		bool "L511CN_2S_NF"
		
	#####################
	#L511C_2C
	#####################
	config L511C_2C
		bool "L511C_2C"
		
	#####################
	#L511C_X2C
	#####################
	config L511C_X2C
		bool "L511C_X2C"
	
	#####################
	#L511EN_2S
	#####################
	config L511EN_2S
		bool "L511EN_2S"
	
	#####################
	#L511E_2S
	#####################
	config L511E_2S
		bool "L511E_2S"	
	
endchoice
```

## app/config/1603/Kconfig
```kconfig
# Kconfig - app target configuration options

choice 
	prompt "APP Target Selection" 

	#####################
	#L501E_3E
	#####################
	config L501E_3E
		bool "L501E_3E"

	#####################
	#L501E_3S
	#####################
	config L501E_3S
		bool "L501E_3S"
	
	#####################
	#L501E_3SKP
	#####################
	config L501E_3SKP
		bool "L501E_3SKP"
	
	#####################
	#L503E_3S
	#####################
	config L503E_3S
		bool "L503E_3S"

	#####################
	#L503E_3C
	#####################
	config L503E_3C
		bool "L503E_3C"
	
	#####################
	#L503C_3E
	#####################
	config L503C_3E
		bool "L503C_3E"
		
	#####################
	#L505C_3E
	#####################
	config L505C_3E
		bool "L505C_3E"
	
	#####################
	#L510C_3S
	#####################
	config L510C_3S
		bool "L510C_3S"
	
	#####################
	#L510CN_3S
	#####################
	config L510CN_3S
		bool "L510CN_3S"
	
	#####################
	#L510E_3S
	#####################
	config L510E_3S
		bool "L510E_3S"
	
	#####################
	#L510LAN_3S
	#####################
	config L510LAN_3S
		bool "L510LAN_3S"
		
	#####################
	#L510E_3C
	#####################
	config L510E_3C
		bool "L510E_3C"
	
	#####################
	#L510EN_3C
	#####################
	config L510EN_3C
		bool "L510EN_3C"
	
endchoice
```

## app/config/1605/Kconfig
```kconfig
# Kconfig - app target configuration options

choice 
	prompt "APP Target Selection" 
	default L511C_5S

	#####################
	#L511C_5S
	#####################
	config L511C_5S
		bool "L511C_5S"
	#####################
	#L511C_5SK
	#####################
	config L511C_5SK
		bool "L511C_5SK"
		
	#####################
	#L511C_5C
	#####################
	config L511C_5C
		bool "L511C_5C"	
		
endchoice
```

## app/config/1606/Kconfig
```kconfig
# Kconfig - app target configuration options

choice 
	prompt "APP Target Selection" 
	default L503C_6C

	#####################
	#L503C_6C
	#####################
	config L503C_6C
		bool "L503C_6C"
	
	#####################
	#L503CN_6C
	#####################
	config L503CN_6C
		bool "L503CN_6C"
	
	#####################
	#L503C_6S
	#####################
	config L503C_6S
		bool "L503C_6S"
	
	#####################
	#L503CN_6S
	#####################
	config L503CN_6S
		bool "L503CN_6S"
	
	#####################
	#L503C_6L
	#####################
	config L503C_6L
		bool "L503C_6L"
	
	#####################
	#L505C_6C
	#####################
	config L505C_6C
		bool "L505C_6C"
	
	#####################
	#L505C_6L
	#####################	
	config L505C_6L
		bool "L505C_6L"
	
	#####################
	#L511C_6C
	#####################
	config L511C_6C
		bool "L511C_6C"
	
	#####################
	#L511C_6D
	#####################
	config L511C_6D
		bool "L511C_6D"
	
	#####################
	#L511C_6S
	#####################
	config L511C_6S
		bool "L511C_6S"
	
	#####################
	#L511CN_6C
	#####################
	config L511CN_6C
		bool "L511CN_6C"

	#####################
	#L511AS_6D
	#####################
	config L511AS_6D
		bool "L511AS_6D"
	
	#####################
	#L511CS_6D
	#####################
	config L511CS_6D
		bool "L511CS_6D"
	
	#####################
	#L511CN_6S
	#####################
	config L511CN_6S
		bool "L511CN_6S"
		
endchoice
```

## app/config/3rdparty/simcom/Kconfig
```kconfig
choice 
	prompt "Build Type Selection" 
	default SIMCOM_BUILD_WITH_LIB 
	
	config SIMCOM_BUILD_WITH_LIB
		bool "SIMCOM_BUILD_WITH_LIB"
	
	config SIMCOM_BUILD_WITH_SOURCE
		bool "SIMCOM_BUILD_WITH_SOURCE"

endchoice
```

## app/config/Kconfig
```kconfig
# Kconfig - general configuration options

mainmenu "MobileTek OpenCPU APP Configuration"

menu "APP Target Configurations"

choice 
	prompt "Kernal Chip Type Selection" 
	default CHIP_1603
	
	config CHIP_1602
	bool "Krenal Chip Type Is 1602"
	
	config CHIP_1603
	bool "Krenal Chip Type Is 1603"
	
	config CHIP_1606
	bool "Krenal Chip Type Is 1606"
	
	config CHIP_1607
	bool "Krenal Chip Type Is 1607"
	
	config CHIP_1605
	bool "Krenal Chip Type Is 1605"

endchoice

if CHIP_1602
source "config/1602/Kconfig"
endif

if CHIP_1603
source "config/1603/Kconfig"
endif

if CHIP_1606
source "config/1606/Kconfig"
endif

if CHIP_1607
source "config/1607/Kconfig"
endif

if CHIP_1605
source "config/1605/Kconfig"
endif

endmenu

menu "APP Function Configurations"

config AUDIO_SUPPORT
	bool "enable audio"
	default y
	help
	  Select this option if you build app with auido demo.
	  	
	config RECORD_SUPPORT
	depends on AUDIO_SUPPORT
	bool "enable record"
	default n
	help
	  Select this option if you build app with auido record demo.
	  
	config AMR_SUPPORT
	depends on AUDIO_SUPPORT
	bool "enable amr audio"
	default n
	help
	  Select this option if you build app with auido amr demo.
	  
	config MP3_SUPPORT
	depends on AUDIO_SUPPORT
	bool "enable mp3 audio"
	default n
	help
	  Select this option if you build app with auido mp3 demo.
	  
config LCD_SUPPORT
	bool "enable lcd"
	default n
	help
	  Select this option if you build app with lcd demo.
	  
config CAM_SUPPORT
	bool "enable camera"
	default n
	help
	  Select this option if you build app with camera demo.	
	  
config AIDIALOG_SUPPORT
	depends on AUDIO_SUPPORT
	bool "enable aidialog support"
	default n
	help
	  Select this option if you build app with aidialog demo.	  
	  
endmenu

menu "Third Party Function Configurations"
	  
config MAAS_SUPPORT
	bool "maas lib support"
	default n
	help
	  Select this option if you want to add mass to app.

config AZURE_SUPPORT
	bool "azure lib support"
	default n
	help
	  Select this option if you want to add azure to app.
	  
config QCLOUD_SUPPORT
	bool "qcloud lib support"
	default n
	help
	  Select this option if you want to add qcloud to app.

config TTS_SUPPORT
	bool "enable TTS"
	depends on AUDIO_SUPPORT
	default n
	help
	  Select this option if you want to build app with TTS demo.
	  
config CJSON_SUPPORT
	bool "enable CJSON"
	default n
	help
	  Select this option if you want to build app with CJSON demo.	  
	  
config AMAZON_SUPPORT
    bool "enable amazon"
	default n
	help
	  Select this option if you want to build app with AMAZON demo.

config SIMCOM_SUPPORT
	bool "enable simcom"
	default n
	help
	  Select this option if you want to build app with SIMCOM demo.

	if SIMCOM_SUPPORT
	source "config/3rdparty/simcom/Kconfig"
	endif
endmenu



menu "Other Configurations"
	  
config IS_XIP
	bool "enable XIP mode"
	depends on CHIP_1602 || CHIP_1606 || CHIP_1607 || CHIP_1605
	default y
	help
	  Select this option if you want to run app in XIP mode.

config IS_COMPRESS
	bool "enable compress app image"
	depends on CHIP_1603
	default n
	help
	  Select this option if you want to compress app image.
	  
endmenu
```
